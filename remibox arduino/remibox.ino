#include "U8glib.h"´

U8GLIB_ST7920_128X64_4X u8g(10);

int offer[] = {0, 0, 0, 0, 0, 0, 0, 0};
float preise[] = {4.3, 3.7, 3, 3.4, 8.9, 7.9, 7.4, 1};
float preiseind[8];
int state[] = {0, 0, 0, 0, 0, 0, 0, 0, 0};
int oldstate[] = {0, 0, 0, 0, 0, 0, 0, 0, 0};
int pin[] = {2,3,4,5,6,7,8,9,A0};
int func = 12;
int funcstate = 0;
int button = 0;
float sum;
int menunum;

//int pfandmin = A0;



const uint8_t logooag[] U8G_PROGMEM = {
  0x00, 0x00, 0x00, 0x00, 0x00, 0x00, 0x00, 0x00, 0x00, 0x00, 0x00, 0x00,
   0x00, 0x00, 0x00, 0x00, 0x00, 0x00, 0x00, 0x00, 0x00, 0x00, 0x00, 0x00,
   0x00, 0x00, 0x00, 0x00, 0x00, 0x00, 0x00, 0x00, 0x00, 0x00, 0x00, 0x00,
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   0x00, 0x00, 0x00, 0x00 };       

void picture(void){
  u8g.drawXBMP( 0, 0, 128, 64, logooag);
} 

void clearLCD()
{
  u8g.firstPage();  
  do{
  } while( u8g.nextPage() );
}

void setup()
{
  if ( u8g.getMode() == U8G_MODE_R3G3B2 ) {
    u8g.setColorIndex(255);     // white
  }
  else if ( u8g.getMode() == U8G_MODE_GRAY2BIT ) {
    u8g.setColorIndex(3);         // max intensity
  }
  else if ( u8g.getMode() == U8G_MODE_BW ) {
    u8g.setColorIndex(1);         // pixel on
  }
  else if ( u8g.getMode() == U8G_MODE_HICOLOR ) {
    u8g.setHiColorByRGB(255,255,255);
  }
  
  u8g.firstPage();  
  do {
    picture();
  } while( u8g.nextPage() );
  delay(2000);
  clearLCD();

  pinMode(pin[0], INPUT);
  pinMode(pin[1], INPUT);
  pinMode(pin[2], INPUT);
  pinMode(pin[3], INPUT);
  pinMode(pin[4], INPUT);
  pinMode(pin[5], INPUT);
  pinMode(pin[6], INPUT);
  pinMode(pin[7], INPUT);
  pinMode(pin[8], INPUT);
  pinMode(A1, INPUT);

  Serial.begin(9600);


}

void loop() {
  operate();
}


void operate(){

    checkButtons();
    int menunum = checkMenu();

    Serial.println(menunum);

    if (menunum == 0)
    {
       u8g.firstPage();  
      do{
        table(1);
      } while( u8g.nextPage() );
   
    }

    if (menunum == 1)
    {
       u8g.firstPage();  
      do{
        table(2);
      } while( u8g.nextPage() );
   
    }

    if (menunum == 2)
    {
       u8g.firstPage();  
      do{
        summe();
      } while( u8g.nextPage() );
   
    }   
}

void table(int option)
{
  
  u8g.drawFrame(0,0,128,16);
  u8g.drawFrame(0,15,128,17);
  u8g.drawFrame(0,32,128,16);
  u8g.drawFrame(0,47,128,17);

  u8g.drawLine(33, 0, 33, 64);
  u8g.drawLine(66, 0, 66, 64);
  u8g.drawLine(99, 0, 99, 64);
  
  u8g.setFont(u8g_font_helvR08);

  menuz();

  if (option == 1)
  {
    firstmenu();
  }
  if (option == 2)
  {
    secmenu();
  }
}

void firstmenu()
{
  char buf[8];
  for (int i = 0; i <= 7; i++)
  {
    if ( i < 4)
    {
      sprintf (buf, "%d", offer[i]); 
      u8g.drawStr(4+(i*33), 28, buf);
    }
      
    if ( i >= 4)
    {
      sprintf (buf, "%d", offer[i]); 
      u8g.drawStr(4+((i-4)*33), 60, buf);
    }
  
  }
}

void secmenu()
{
   char buf2[10];
   char buf3[6];
  
   for (int i = 0; i <= 7; i++)
   {
    if ( i < 4)
    {
      dtostrf(preiseind[i], 4, 1, buf3);
      sprintf(buf2,"%s", buf3); 
      u8g.drawStr(1+(i*33), 28, buf2);
    }
      
    if ( i >= 4)
    {
      dtostrf(preiseind[i], 4, 1, buf3);
      sprintf(buf2,"%s", buf3);
      u8g.drawStr(1+((i-4)*33), 60, buf2);
    }
   }
}

void summe()
{
  u8g.setFont(u8g_font_helvB12);
  u8g.drawStr(28, 25, "Summe: ");
  char sumbuf[10];
  char sumbuf2[6];
  dtostrf(sum, 4, 1, sumbuf2);
  sprintf(sumbuf,"%s", sumbuf2);
  u8g.drawStr(28, 40, sumbuf);
  
}

void checkButtons()
{
  
   for (int i = 0; i<=7; i++)
   {
     preiseind[i] = preise[i]*offer[i];
   }
  
  for (int i = 0; i<= 8; i++)
    {
      state[i] = digitalRead(pin[i]);
      
      if (state[i] != oldstate[i])
      {
        if (state[i] == HIGH)
        {
          funcstate = digitalRead(func);
          if (funcstate == HIGH && i != 7 )
          {
            if (offer[i] > 0)
            {
              if ( i != 8)
              {
                offer[i]--;
                sum -= preise[i];
              }
              
            }
          }
          else if (funcstate == LOW) 
          {
            if ( i != 8)
            {
             offer[i]++;
             if ( i != 7)
             {
              sum += preise[i];
             } 
            }
            if (i == 8 && offer[7] > 0)
            {
             offer[7]--;
            }
            
            
          }
  
        }

      }
      delay(5);
      oldstate[i] = state[i];
      
    }

   
}

int checkMenu()
{
  int value = analogRead(A1);
  
  int ret = map(value, 0, 1023, 0, 3);

  return ret;
  
}

void menuz()
{
   
   u8g.drawStr(4+(0*33), 12, "B");
   u8g.drawStr(4+(1*33), 12, "M");
   u8g.drawStr(4+(2*33), 12, "BL");
   u8g.drawStr(4+(3*33), 12, "KM");
   
   u8g.drawStr(4+(0*33), 44, "S");
   u8g.drawStr(4+(1*33), 44, "H");
   u8g.drawStr(4+(2*33), 44, "V");
   u8g.drawStr(4+(3*33), 44, "Pf");
    
}
